## config/boards/shields/ergotonic49/Kconfig.defconfig
```kconfig
# Copyright (c) 2021 The ZMK Contributors
# SPDX-License-Identifier: MIT

if SHIELD_ERGOTONIC49

config ZMK_KEYBOARD_NAME
    default "Ergotonic49"

endif
```

## config/boards/shields/rcorne/Kconfig.shield
```kconfig
# Copyright (c) 2020 Pete Johanson
# SPDX-License-Identifier: MIT


config SHIELD_RCORNE_RIGHT
	def_bool $(shields_list_contains,rcorne_right)

config SHIELD_RCORNE_LEFT
	def_bool $(shields_list_contains,rcorne_left)
```

## config/west.yml
```yaml
manifest:
  remotes:
    - name: zmkfirmware
      url-base: https://github.com/zmkfirmware
    - name: petejohanson
      url-base: https://github.com/petejohanson
    - name: justussoh
      url-base: https://github.com/justussoh

  projects:
    # - name: zmk
    #   remote: petejohanson
    #   revision: display/bongo-cat-widget

    - name: zmk
      remote: zmkfirmware
      revision: main
      import: app/west.yml
  self:
    path: config
```
